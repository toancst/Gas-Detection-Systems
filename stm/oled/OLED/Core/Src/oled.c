// ====== oled.c ======
#include "oled.h"
#include "i2c.h"
#include <string.h>
#include <stdio.h>
#include "system.h"

const uint8_t font5x8[][5] = {
    // A–Z (0–25)
    {0x7E,0x11,0x11,0x11,0x7E}, // A
    {0x7F,0x49,0x49,0x49,0x36}, // B
    {0x3E,0x41,0x41,0x41,0x22}, // C
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    {0x61,0x51,0x49,0x45,0x43}, // Z

    // a–z (26–51)
    {0x20,0x54,0x54,0x54,0x78}, // a
    {0x7F,0x48,0x44,0x44,0x38}, // b
    {0x38,0x44,0x44,0x44,0x20}, // c
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    {0x44,0x64,0x54,0x4C,0x44}, // z

    // 0–9 (52–61)
    {0x3E,0x45,0x49,0x51,0x3E}, // 0
    {0x00,0x41,0x7F,0x40,0x00}, // 1
    {0x42,0x61,0x51,0x49,0x46}, // 2
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    {0x06,0x49,0x49,0x29,0x1E}, // 9

    // Space (62)
    {0x00,0x00,0x00,0x00,0x00}
};

uint8_t SSD1306_Command(uint8_t cmd) {
    return I2C_WriteByte(0x3C, 0x00, cmd);
}

uint8_t SSD1306_Data(uint8_t data) {
    return I2C_WriteByte(0x3C, 0x40, data);
}

uint8_t SSD1306_Init(void) {
    Delay_ms(100);
    const uint8_t init_seq[] = {
        0xAE, 0xD5, 0x80, 0xA8, 0x3F, 0xD3, 0x00, 0x40, 0x8D, 0x14,
        0x20, 0x00, 0xA1, 0xC8, 0xDA, 0x12, 0x81, 0xCF, 0xD9, 0xF1,
        0xDB, 0x40, 0xA4, 0xA6, 0xAF
    };
    for (int i = 0; i < sizeof(init_seq); i++) {
        if (!SSD1306_Command(init_seq[i])) return 0;
    }
    return 1;
}

void SSD1306_SetCursor(uint8_t col, uint8_t page) {
    SSD1306_Command(0xB0 + page);
    SSD1306_Command(0x00 + (col & 0x0F));
    SSD1306_Command(0x10 + ((col >> 4) & 0x0F));
}

void SSD1306_Clear(void) {
    for (uint8_t page = 0; page < 8; page++) {
        SSD1306_SetCursor(0, page);
        for (uint8_t col = 0; col < 128; col++) {
            SSD1306_Data(0x00);
        }
    }
}

void SSD1306_PrintChar(char ch) {
    const uint8_t* chr;
    if (ch >= 'A' && ch <= 'Z') chr = font5x8[ch - 'A'];
    else if (ch >= 'a' && ch <= 'z') chr = font5x8[ch - 'a' + 26];
    else if (ch >= '0' && ch <= '9') chr = font5x8[ch - '0' + 52];
    else chr = font5x8[62];

    for (int i = 0; i < 5; i++) SSD1306_Data(chr[i]);
    SSD1306_Data(0x00);
}

void SSD1306_PrintTextCentered(uint8_t page, const char* str) {
    uint8_t len = strlen(str);
    uint8_t col = (128 - len * 6) / 2;
    SSD1306_SetCursor(col, page);
    while (*str) SSD1306_PrintChar(*str++);
}

void SSD1306_DisplayStatus(uint8_t current_mode, uint8_t seconds_left) {
    char buffer[32];
    SSD1306_Clear();
    SSD1306_PrintTextCentered(1, "DEVICE STATUS");
    sprintf(buffer, "MODE %d", current_mode);
    SSD1306_PrintTextCentered(3, buffer);
    if (seconds_left > 0) sprintf(buffer, "TIME %ds", seconds_left);
    else sprintf(buffer, "READY");
    SSD1306_PrintTextCentered(5, buffer);
}
